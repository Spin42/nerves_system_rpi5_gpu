## package/nvidia-cuda-bundles/Config.in
```kconfig
config BR2_PACKAGE_NVIDIA_CUDA_BUNDLES
	bool "NVIDIA CUDA/cuDNN/NCCL from external bundles"
	depends on BR2_PACKAGE_NVIDIA_DRIVER_AARCH64
	depends on !BR2_PACKAGE_NVIDIA_CUDA_TOOLKIT
	depends on !BR2_PACKAGE_NVIDIA_CUDNN
	depends on !BR2_PACKAGE_NVIDIA_NCCL
	help
	  Keep the CUDA toolkit, cuDNN and NCCL libraries out of the root
	  filesystem. They are shipped as separate squashfs bundles (built by
	  scripts/build-nvidia-bundles.sh), stored on the application data
	  partition in /root/nvidia/ and loop-mounted at boot by nvidia-init
	  on /opt/nvidia/<component>.

	  This package installs the list of expected bundles
	  (/etc/nvidia-bundles), the mount points and /usr/local/cuda.

comment "nvidia-cuda-bundles is exclusive with the in-image CUDA/cuDNN/NCCL packages"
	depends on BR2_PACKAGE_NVIDIA_CUDA_TOOLKIT || BR2_PACKAGE_NVIDIA_CUDNN || BR2_PACKAGE_NVIDIA_NCCL
```

## package/nvidia-proprietary-modules-aarch64/Config.in
```kconfig
config BR2_PACKAGE_NVIDIA_PROPRIETARY_MODULES_AARCH64
	bool "NVIDIA proprietary kernel modules (pre-Turing GPUs)"
	depends on BR2_LINUX_KERNEL
	depends on BR2_PACKAGE_NVIDIA_DRIVER_AARCH64
	help
	  NVIDIA's proprietary kernel modules from the same driver release,
	  for GPUs the open modules don't support (Maxwell, Pascal, Volta:
	  no GSP), e.g. the Tesla P4.

	  Installed in /usr/lib/nvidia-proprietary/ (outside the module
	  search path). nvidia-init loads them only when the open modules
	  find no supported GPU.

	  Experimental on the Raspberry Pi 5: its PCIe is not cache coherent
	  and the closed part of this driver assumes it is. The open
	  interface layer is patched to allocate system memory uncached
	  (module parameter nv_force_uncached_sysmem).
```
