## Config.in
```kconfig
# Add project-specific packages for Buildroot here
#
# If these are non-proprietary, please consider contributing them back to
# Nerves or Buildroot.

source "$NERVES_DEFCONFIG_DIR/package/nvidia-driver-aarch64/Config.in"
source "$NERVES_DEFCONFIG_DIR/package/nvidia-open-gpu-modules-aarch64/Config.in"
source "$NERVES_DEFCONFIG_DIR/package/nvidia-cuda-toolkit/Config.in"
source "$NERVES_DEFCONFIG_DIR/package/nvidia-nccl/Config.in"
source "$NERVES_DEFCONFIG_DIR/package/nvidia-cudnn/Config.in"
source "$NERVES_DEFCONFIG_DIR/package/ffmpeg-compat/Config.in"
source "$NERVES_DEFCONFIG_DIR/package/ffmpeg-compat5/Config.in"
```

## package/ffmpeg-compat/Config.in
```kconfig
config BR2_PACKAGE_FFMPEG_COMPAT
	bool "FFmpeg 4.4 Compatibility Libraries"
	help
	  FFmpeg 4.4 compatibility libraries for applications requiring
	  older FFmpeg ABI (libavcodec.so.58, libavformat.so.58,
	  libavutil.so.56, libswscale.so.5).

	  https://ffmpeg.org/
```

## package/ffmpeg-compat5/Config.in
```kconfig
config BR2_PACKAGE_FFMPEG_COMPAT5
	bool "FFmpeg 5.1 Compatibility Libraries"
	help
	  FFmpeg 5.1 compatibility libraries for applications requiring
	  FFmpeg 5.x ABI (libavcodec.so.59, libavformat.so.59,
	  libavutil.so.57, libswscale.so.6).

	  https://ffmpeg.org/
```

## package/nvidia-cuda-toolkit/Config.in
```kconfig
config BR2_PACKAGE_NVIDIA_CUDA_TOOLKIT
	bool "NVIDIA CUDA Toolkit"
	depends on BR2_aarch64 && BR2_PACKAGE_NVIDIA_DRIVER_AARCH64 && BR2_PACKAGE_NVIDIA_OPEN_GPU_MODULES_AARCH64
	help
	  NVIDIA CUDA Toolkit for aarch64 (ARM SBSA).

	  This package installs the CUDA runtime libraries and tools
	  needed for running CUDA applications.

	  https://developer.nvidia.com/cuda-toolkit

comment "nvidia-cuda-toolkit needs aarch64, nvidia-driver-aarch64 and nvidia-open-gpu-modules-aarch64"
	depends on !BR2_aarch64 || !BR2_PACKAGE_NVIDIA_DRIVER_AARCH64 || !BR2_PACKAGE_NVIDIA_OPEN_GPU_MODULES_AARCH64
```

## package/nvidia-cudnn/Config.in
```kconfig
config BR2_PACKAGE_NVIDIA_CUDNN
  bool "NVIDIA cuDNN (Deep Neural Network Library)"
  depends on BR2_aarch64 && BR2_PACKAGE_NVIDIA_DRIVER_AARCH64 && BR2_PACKAGE_NVIDIA_OPEN_GPU_MODULES_AARCH64
    help
      NVIDIA CUDA Deep Neural Network Library (cuDNN) for aarch64.

      cuDNN provides highly tuned implementations for standard routines
      such as forward and backward convolution, attention, matmul,
      pooling, and normalization.

      Installs libcudnn runtime libraries and development headers
      compatible with CUDA 12.x.

      https://developer.nvidia.com/cudnn

comment "cuDNN needs aarch64, nvidia-driver-aarch64 and nvidia-open-gpu-modules-aarch64"
  depends on !BR2_aarch64 || !BR2_PACKAGE_NVIDIA_DRIVER_AARCH64 || !BR2_PACKAGE_NVIDIA_OPEN_GPU_MODULES_AARCH64
```

## package/nvidia-driver-aarch64/Config.in
```kconfig
config BR2_PACKAGE_NVIDIA_DRIVER_AARCH64
    bool "NVIDIA Userspace Drivers"
    depends on BR2_aarch64 && BR2_LINUX_KERNEL && BR2_USE_MMU # fork()
    select BR2_PACKAGE_HAS_LIBOPENCL
    help
      NVIDIA userspace drivers and libraries extracted from
      the official .run installer.

      https://www.nvidia.com/drivers

if BR2_PACKAGE_NVIDIA_DRIVER_AARCH64

config BR2_PACKAGE_PROVIDES_LIBOPENCL
    default "nvidia-driver-aarch64"

endif
```

## package/nvidia-nccl/Config.in
```kconfig
config BR2_PACKAGE_NVIDIA_NCCL
  bool "NVIDIA NCCL (Collective Communication Library)"
  depends on BR2_aarch64 && BR2_PACKAGE_NVIDIA_DRIVER_AARCH64 && BR2_PACKAGE_NVIDIA_OPEN_GPU_MODULES_AARCH64
    help
      NVIDIA Collective Communication Library (NCCL) for aarch64.

      Installs libnccl runtime libraries and development headers
      compatible with the configured CUDA toolkit.

      https://developer.nvidia.com/nccl

comment "NCCL needs aarch64, nvidia-driver-aarch64 and nvidia-open-gpu-modules-aarch64"
  depends on !BR2_aarch64 || !BR2_PACKAGE_NVIDIA_DRIVER_AARCH64 || !BR2_PACKAGE_NVIDIA_OPEN_GPU_MODULES_AARCH64
```

## package/nvidia-open-gpu-modules-aarch64/Config.in
```kconfig
config BR2_PACKAGE_NVIDIA_OPEN_GPU_MODULES_AARCH64
  bool "NVIDIA Open GPU Kernel Modules (aarch64)"
    depends on BR2_LINUX_KERNEL && BR2_PACKAGE_NVIDIA_DRIVER_AARCH64 && BR2_USE_MMU
    help
      NVIDIA open GPU kernel modules from mariobalanica's fork
      with non-coherent ARM fixes for Raspberry Pi 5.

      https://github.com/NVIDIA/open-gpu-kernel-modules
```
